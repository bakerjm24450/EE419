## lab1/main/Kconfig.projbuild
```kconfig
menu "EE 419 Configuration"

    config LED_RED_PIN
        int "Red LED gpio number"
        default 9
        help
            GPIO number for the red LED.
        
    config LED_GREEN_PIN
        int "Green LED gpio number"
        default 6
        help
            GPIO number for the green LED.
            
    config LED_BLUE_PIN
        int "Blue LED gpio number"
        default 5
        help
            GPIO number for the blue LED.

    config WIFI_SSID
        string "WiFi SSID"
        default "Replace with given SSID"
        help
            SSID (network name) to connect to

    config WIFI_PASSWORD
        string "WiFi Password"
        default "Replace with given password"
        help
            WiFi password (WPA2)            

    config SNTP_SERVER
        string "SNTP server"
        default "pool.ntp.org"
        help
            SNTP (network time) server

    config SNTP_TIME_ZONE
        string "Time zone"
        default "EST5EDT,M3.2.0,M11.1.0"
        help
            Time zone setting using 

endmenu
```

## lab2/main/Kconfig.projbuild
```kconfig
menu "EE 419 Configuration"

    config LED_RED_PIN
        int "Red LED gpio number"
        default 9
        help
            GPIO number for the red LED.
        
    config LED_GREEN_PIN
        int "Green LED gpio number"
        default 6
        help
            GPIO number for the green LED.
            
    config LED_BLUE_PIN
        int "Blue LED gpio number"
        default 5
        help
            GPIO number for the blue LED.

    config WIFI_SSID
        string "WiFi SSID"
        default "Replace with given SSID"
        help
            SSID (network name) to connect to

    config WIFI_PASSWORD
        string "WiFi Password"
        default "Replace with given password"
        help
            WiFi password (WPA2)            

    config SNTP_SERVER
        string "SNTP server"
        default "pool.ntp.org"
        help
            SNTP (network time) server

    config SNTP_TIME_ZONE
        string "Time zone"
        default "EST5EDT,M3.2.0,M11.1.0"
        help
            Time zone setting using 

    menu "PN532 Interface"
        choice PN532_INTERFACE_TYPE
            prompt "Choose interface type for PN532"

            config PN532_SPI
                bool "SPI interface"

            config PN532_I2C
                bool "I2C interface"
            
        endchoice

        menu "PN532 SPI configuration"
            visible if PN532_SPI

            config PN532_SPI_MISO
                int "PN532 SPI MISO Pin"
                default 37
                help
                    GPIO pin used for SPI MISO for PN532
                    
            config PN532_SPI_MOSI
                int "PN532 SPI MOSI Pin"
                default 35
                help
                    GPIO pin used for SPI MOSI for PN532
                    
            config PN532_SPI_SCK
                int "PN532 SPI SCK Pin"
                default 36
                help
                    GPIO pin used for SPI SCK for PN532
                    
            config PN532_SPI_CS
                int "PN532 SPI CS Pin"
                default 40
                help
                    GPIO pin used for SPI CS for PN532
                    
            config PN532_SPI_IRQ
                int "PN532 SPI IRQ Pin"
                default 41
                help
                    GPIO pin used for SPI IRQ for PN532

            config PN532_SPI_CLOCK_RATE
                int "PN532 SPI Clock Rate"
                default 1000000
                help
                    SPI clock rate in Hz for PN532

            config PN532_SPI_HOST_NFC
                int "PN532 SPI HOST Number"
                range 0 2
                default 2
                help
                    Set the SPI host used to communicate with PN532
        endmenu
        
        menu "PN532 I2C configuration"
            visible if PN532_I2C

            config PN532_I2C_SDA
                int "PN532 I2C SDA Pin"
                default 23
                help
                    GPIO pin used for I2C SDA for PN532

            config PN532_I2C_SCL
                int "PN532 I2C SCL Pin"
                default 22
                help
                    GPIO pin used for I2C SCL for PN532

            config PN532_I2C_PORT_NFC
                int "PN532 I2C Port Number"
                range 0 1
                default 0
                help
                    Set the I2C port used to communicate with PN532
        endmenu

    endmenu
endmenu
```

## lab4/main/Kconfig.projbuild
```kconfig
menu "EE 419 Configuration"

    config LED_RED_PIN
        int "Red LED gpio number"
        default 9
        help
            GPIO number for the red LED.
        
    config LED_GREEN_PIN
        int "Green LED gpio number"
        default 6
        help
            GPIO number for the green LED.
            
    config LED_BLUE_PIN
        int "Blue LED gpio number"
        default 5
        help
            GPIO number for the blue LED.

    config WIFI_SSID
        string "WiFi SSID"
        default "Replace with given SSID"
        help
            SSID (network name) to connect to

    config WIFI_PASSWORD
        string "WiFi Password"
        default "Replace with given password"
        help
            WiFi password (WPA2)            

    config SNTP_SERVER
        string "SNTP server"
        default "pool.ntp.org"
        help
            SNTP (network time) server

    config SNTP_TIME_ZONE
        string "Time zone"
        default "EST5EDT,M3.2.0,M11.1.0"
        help
            Time zone setting using 

    config PN532_SPI_MISO
        int "PN532 SPI MISO Pin"
        default 37
        help
            GPIO pin used for SPI MISO for PN532
            
    config PN532_SPI_MOSI
        int "PN532 SPI MOSI Pin"
        default 35
        help
            GPIO pin used for SPI MOSI for PN532
            
    config PN532_SPI_SCK
        int "PN532 SPI SCK Pin"
        default 36
        help
            GPIO pin used for SPI SCK for PN532
            
    config PN532_SPI_CS
        int "PN532 SPI CS Pin"
        default 40
        help
            GPIO pin used for SPI CS for PN532
            
    config PN532_SPI_IRQ
        int "PN532 SPI IRQ Pin"
        default 41
        help
            GPIO pin used for SPI IRQ for PN532

    config PN532_SPI_CLOCK_RATE
        int "PN532 SPI Clock Rate"
        default 1000000
        help
            SPI clock rate in Hz for PN532

    config PN532_SPI_HOST_NFC
        int "PN532 SPI HOST Number"
        range 0 2
        default 2
        help
            Set the SPI host used to communicate with PN532

    config MQTT_BROKER
        string "MQTT broker address"
        default "Replace with local MQTT broker"
        help
            Address of local server used as MQTT broker

    config MQTT_PORT
        int "Port used for MQTT communication"
        default 1883
        help
            Port on broker used for MQTT communication
                        
endmenu
```

## lab4/sdkconfig.defaults
```kconfig
# Common settings for all our ESP32 variants

# FreeRTOS
# Kernel
CONFIG_FREERTOS_HZ=1000

# Log level
CONFIG_LOG_DEFAULT_LEVEL_WARN=y
CONFIG_LOG_DEFAULT_LEVEL=2
CONFIG_LOG_MAXIMUM_LEVEL_DEBUG=y
CONFIG_LOG_MAXIMUM_LEVEL=4
CONFIG_LOG_DYNAMIC_LEVEL_CONTROL=y

#
# ESP-MQTT Configurations
#
CONFIG_MQTT_PROTOCOL_311=y
CONFIG_MQTT_PROTOCOL_5=y
CONFIG_MQTT_TRANSPORT_SSL=y
# end of ESP-MQTT Configurations
```

## lab5/main/Kconfig.projbuild
```kconfig
menu "EE 419 Configuration"

    config LED_RED_PIN
        int "Red LED gpio number"
        default 9
        help
            GPIO number for the red LED.
        
    config LED_GREEN_PIN
        int "Green LED gpio number"
        default 6
        help
            GPIO number for the green LED.
            
    config LED_BLUE_PIN
        int "Blue LED gpio number"
        default 5
        help
            GPIO number for the blue LED.

    config WIFI_SSID
        string "WiFi SSID"
        default "Replace with given SSID"
        help
            SSID (network name) to connect to

    config WIFI_PASSWORD
        string "WiFi Password"
        default "Replace with given password"
        help
            WiFi password (WPA2)            

    config SNTP_SERVER
        string "SNTP server"
        default "pool.ntp.org"
        help
            SNTP (network time) server

    config SNTP_TIME_ZONE
        string "Time zone"
        default "EST5EDT,M3.2.0,M11.1.0"
        help
            Time zone setting using 

    config MQTT_BROKER
        string "AWS Endpoint"
        default "Replace with your AWS endpoint"
        help
            Name of MQTT broker

    config MQTT_PORT
        int "MQTT port"
        default 443
        help
            Port used for MQTT broker

    config MQTT_QOS
        int "MQTT Quality of Service"
        range 0 1
        default 1
        help
            QoS value for MQTT messages
    
    config MQTT_NAME
        string "AWS Thing Name"
        default "esp_1"
        help
            Replace with name of Thing, either esp_1 or esp_2

    menu "PN532 Interface"
        choice PN532_INTERFACE_TYPE
            prompt "Choose interface type for PN532"

            config PN532_I2C
                bool "I2C interface"
            
            config PN532_SPI
                bool "SPI interface"

        endchoice

        menu "PN532 I2C configuration"
            visible if PN532_I2C

            config PN532_I2C_SDA
                int "PN532 I2C SDA Pin"
                default 23
                help
                    GPIO pin used for I2C SDA for PN532

            config PN532_I2C_SCL
                int "PN532 I2C SCL Pin"
                default 22
                help
                    GPIO pin used for I2C SCL for PN532

            config PN532_I2C_PORT_NFC
                int "PN532 I2C Port Number"
                range 0 1
                default 0
                help
                    Set the I2C port used to communicate with PN532
        endmenu

        menu "PN532 SPI configuration"
            visible if PN532_SPI

            config PN532_SPI_MISO
                int "PN532 SPI MISO Pin"
                help
                    GPIO pin used for SPI MISO for PN532
                    
            config PN532_SPI_MOSI
                int "PN532 SPI MOSI Pin"
                help
                    GPIO pin used for SPI MOSI for PN532
                    
            config PN532_SPI_SCK
                int "PN532 SPI SCK Pin"
                help
                    GPIO pin used for SPI SCK for PN532
                    
            config PN532_SPI_CS
                int "PN532 SPI CS Pin"
                help
                    GPIO pin used for SPI CS for PN532
                    
            config PN532_SPI_IRQ
                int "PN532 SPI IRQ Pin"
                help
                    GPIO pin used for SPI IRQ for PN532

            config PN532_SPI_CLOCK_RATE
                int "PN532 SPI Clock Rate"
                default 1000000
                help
                    SPI clock rate in Hz for PN532

            config PN532_SPI_HOST_NFC
                int "PN532 SPI HOST Number"
                range 0 3
                default 2
                help
                    Set the SPI host used to communicate with PN532
        endmenu
        
    endmenu
endmenu
```

## lab5/sdkconfig.defaults.esp32s2
```kconfig
# Setting specific to ESP32-S2

#
# Serial flasher config
#
CONFIG_ESPTOOLPY_FLASHSIZE_4MB=y
CONFIG_ESPTOOLPY_FLASHSIZE="4MB"

#
# ESP System Settings
#
CONFIG_ESP_DEFAULT_CPU_FREQ_MHZ_240=y
CONFIG_ESP_DEFAULT_CPU_FREQ_MHZ=240

CONFIG_ESP_CONSOLE_USB_SERIAL_JTAG=y
CONFIG_ESP_CONSOLE_SECONDARY_NONE=y
CONFIG_ESP_CONSOLE_USB_SERIAL_JTAG_ENABLED=y
CONFIG_ESP_CONSOLE_UART_NUM=-1
CONFIG_ESP_CONSOLE_ROM_SERIAL_PORT_NUM=4

#
# SPI RAM config
#
CONFIG_SPIRAM_MODE_QUAD=y
CONFIG_SPIRAM_TYPE_AUTO=y
CONFIG_SPIRAM_USE_MALLOC=y
CONFIG_SPIRAM_TRY_ALLOCATE_WIFI_LWIP=y

#
# RGB LED for EE 419
#
CONFIG_LED_RED_PIN=9
CONFIG_LED_GREEN_PIN=17
CONFIG_LED_BLUE_PIN=18

#
# SPI interface for EE 419
#
CONFIG_PN532_SPI_MISO=37
CONFIG_PN532_SPI_MOSI=35
CONFIG_PN532_SPI_SCK=36
CONFIG_PN532_SPI_CS=40
CONFIG_PN532_SPI_IRQ=41
```
